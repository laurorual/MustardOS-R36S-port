## port/buildroot-batch/package/muos-r35s-batch/Config.in
```kconfig
config BR2_PACKAGE_MUOS_R35S_BATCH
	bool "R35S qualified resident batch contract"
	depends on BR2_aarch64
	depends on BR2_PACKAGE_MUOS_R35S_SESSION
	default n
	help
	  Install an explicitly supplied, qualified C122 public payload.
	  Requires the C105 caller and C112 resident preparation in the image.
	  Manual activation only; no startup, reboot or ROM payload.
```

## port/buildroot-frontend/Config.in
```kconfig
menu "muOS R35S frontend libraries (experimental provider)"
source "$BR2_EXTERNAL_MUOS_R35S_FRONTEND_PATH/package/muos-frontend-libs/Config.in"
endmenu
```

## port/buildroot-frontend/package/muos-frontend-libs/Config.in
```kconfig
config BR2_PACKAGE_MUOS_FRONTEND_LIBS
	bool "muOS frontend shared libraries (no services)"
	depends on BR2_aarch64
	depends on BR2_INSTALL_LIBSTDCPP
	depends on BR2_USE_WCHAR
	depends on BR2_TOOLCHAIN_HAS_THREADS
	depends on BR2_TOOLCHAIN_HAS_SYNC_4
	depends on BR2_TOOLCHAIN_GCC_AT_LEAST_4_9
	depends on !BR2_STATIC_LIBS
	depends on BR2_PACKAGE_HAS_LIBEGL
	depends on BR2_PACKAGE_HAS_LIBGLES
	depends on BR2_PACKAGE_FFMPEG_ARCH_SUPPORTS
	default n
	select BR2_PACKAGE_SDL2
	select BR2_PACKAGE_SDL2_IMAGE
	select BR2_PACKAGE_SDL2_MIXER
	select BR2_PACKAGE_SDL2_TTF
	select BR2_PACKAGE_HARFBUZZ
	select BR2_PACKAGE_FREETYPE
	select BR2_PACKAGE_LIBPNG
	select BR2_PACKAGE_LIBCURL
	select BR2_PACKAGE_FFMPEG
	select BR2_PACKAGE_FFMPEG_SWSCALE
	select BR2_PACKAGE_LIBARCHIVE
	select BR2_PACKAGE_OPENSSL
	select BR2_PACKAGE_ZLIB
	help
	  Build libui, libmuxcom, libmuxmod and libplutosvg from pinned
	  source, including the static PIC mojibake dependency. No private
	  frontend link SDK is used. This is the foundation variant, without
	  the C46 diagnostic selection patches. Installs libraries only;
	  it neither enables the historical muxretro recipe nor a service.
```

## port/buildroot-libretro/Config.in
```kconfig
menu "muOS R35S libretro cores"
source "$BR2_EXTERNAL_MUOS_R35S_LIBRETRO_PATH/package/muos-gambatte/Config.in"
endmenu
```

## port/buildroot-libretro/package/muos-gambatte/Config.in
```kconfig
config BR2_PACKAGE_MUOS_GAMBATTE
	bool "muOS Gambatte Game Boy core (private experiment)"
	depends on BR2_aarch64
	depends on BR2_INSTALL_LIBSTDCPP
	help
	  Pinned RGB565, network-disabled core. No ROM, caller, boot hook or
	  save policy is installed. Combined source-license review remains
	  pending; redistribution is disabled for this experimental package.
```

## port/buildroot-muxretro/Config.in
```kconfig
menu "muOS R35S muxretro provider consumer"
source "$BR2_EXTERNAL_MUOS_R35S_MUXRETRO_PATH/package/muos-muxretro-provider/Config.in"
endmenu
```

## port/buildroot-muxretro/package/muos-muxretro-provider/Config.in
```kconfig
config BR2_PACKAGE_MUOS_MUXRETRO_PROVIDER
	bool "muOS muxretro (frontend provider, manual caller only)"
	depends on BR2_aarch64
	depends on BR2_INSTALL_LIBSTDCPP
	depends on BR2_USE_WCHAR
	depends on BR2_TOOLCHAIN_HAS_THREADS
	depends on BR2_TOOLCHAIN_HAS_SYNC_4
	depends on BR2_TOOLCHAIN_GCC_AT_LEAST_4_9
	depends on !BR2_STATIC_LIBS
	depends on BR2_PACKAGE_HAS_LIBEGL
	depends on BR2_PACKAGE_HAS_LIBGLES
	depends on BR2_PACKAGE_FFMPEG_ARCH_SUPPORTS
	depends on !BR2_PACKAGE_MUOS_MUXRETRO
	default n
	select BR2_PACKAGE_MUOS_FRONTEND_LIBS
	help
	  Build the pinned native host with matching frontend headers and
	  rcheevos, linking the muos-frontend-libs staging installation.
	  Include the MUOS_R35S_FRONTEND external tree as well.
	  No private prebuilt frontend SDK, core, ROM, save or service is
	  installed. Mutually exclusive with the historical SDK host.
```

## port/buildroot/Config.in
```kconfig
source "$BR2_EXTERNAL_MUOS_R35S_PATH/package/muos-core/Config.in"
source "$BR2_EXTERNAL_MUOS_R35S_PATH/package/muos-r35s-profile/Config.in"
source "$BR2_EXTERNAL_MUOS_R35S_PATH/package/muos-r35s-session/Config.in"
source "$BR2_EXTERNAL_MUOS_R35S_PATH/package/muos-r35s-boot/Config.in"
source "$BR2_EXTERNAL_MUOS_R35S_PATH/package/muos-r35s-wifi-only/Config.in"
source "$BR2_EXTERNAL_MUOS_R35S_PATH/package/muos-r35s-launcher-once/Config.in"
source "$BR2_EXTERNAL_MUOS_R35S_PATH/package/muos-save-store/Config.in"
source "$BR2_EXTERNAL_MUOS_R35S_PATH/package/muos-muxretro/Config.in"
source "$BR2_EXTERNAL_MUOS_R35S_PATH/package/muos-sdl-audio-probe/Config.in"
```

## port/buildroot/package/muos-bootrec/Config.in
```kconfig
config BR2_PACKAGE_MUOS_BOOTREC
	bool "muOS R35S boot record tool"
	help
	  /usr/libexec/muos-bootrec: encodes and decodes the boot records
	  (sectors 32-34) the port U-Boot boots from, with the same
	  bootrec.c that U-Boot uses. Driven by /usr/libexec/muos-boot-slot.
```

## port/buildroot/package/muos-core/Config.in
```kconfig
config BR2_PACKAGE_MUOS_CORE
	bool "muOS R35S core bring-up"
	depends on BR2_aarch64
	depends on BR2_INIT_BUSYBOX
	depends on BR2_ROOTFS_DEVICE_CREATION_DYNAMIC_EUDEV
	depends on BR2_TOOLCHAIN_HAS_THREADS
	depends on BR2_USE_WCHAR
	depends on BR2_PACKAGE_BUSYBOX_SHOW_OTHERS
	select BR2_PACKAGE_JQ
	select BR2_PACKAGE_PROCPS_NG
	depends on BR2_PACKAGE_DBUS
	depends on BR2_PACKAGE_ALSA_UTILS_ALSACTL
	depends on BR2_PACKAGE_ALSA_UTILS_AMIXER
	depends on BR2_PACKAGE_ALSA_UTILS_APLAY
	depends on BR2_PACKAGE_PIPEWIRE
	depends on BR2_PACKAGE_WIREPLUMBER
	help
	  Rebuild muvarctl/mulog/muinput/fnv1a against this firmware sysroot.
	  Install a limited core/audio bootstrap, not the full muOS sysinit.
```

## port/buildroot/package/muos-muxretro/Config.in
```kconfig
config BR2_MUOS_PRIVATE_FRONTEND_SDK
	bool "Prepared private muOS frontend link SDK"
	depends on BR2_aarch64
	default n
	help
	  Use the separately prepared and hash-pinned Phase 4 frontend libraries.
	  This is a private SDK prerequisite, not a Buildroot library provider.
	  Missing or changed SDK files cause the host package build to fail.

config BR2_PACKAGE_MUOS_MUXRETRO
	bool "muOS muxretro native host (manual caller only)"
	depends on BR2_MUOS_PRIVATE_FRONTEND_SDK
	depends on BR2_INSTALL_LIBSTDCPP
	depends on BR2_USE_WCHAR
	depends on BR2_TOOLCHAIN_HAS_THREADS
	depends on BR2_TOOLCHAIN_HAS_SYNC_4
	depends on BR2_TOOLCHAIN_GCC_AT_LEAST_4_9
	depends on !BR2_STATIC_LIBS
	depends on BR2_PACKAGE_HAS_LIBEGL
	depends on BR2_PACKAGE_HAS_LIBGLES
	default n
	select BR2_PACKAGE_SDL2
	select BR2_PACKAGE_SDL2_IMAGE
	select BR2_PACKAGE_SDL2_MIXER
	select BR2_PACKAGE_SDL2_TTF
	select BR2_PACKAGE_HARFBUZZ
	select BR2_PACKAGE_FREETYPE
	select BR2_PACKAGE_LIBPNG
	select BR2_PACKAGE_LIBCURL
	select BR2_PACKAGE_LIBARCHIVE
	select BR2_PACKAGE_OPENSSL
	select BR2_PACKAGE_ZLIB
	help
	  Build the pinned C50 source from scratch with its rcheevos dependency.
	  Installs no core, ROM, save, runtime service or automatic launcher.
	  Native callers must supply the reviewed private runtime and storage.
	  Full frontend-library provider integration remains separate work.
```

## port/buildroot/package/muos-r35s-boot/Config.in
```kconfig
config BR2_PACKAGE_MUOS_R35S_BOOT
	bool "R35S Panel 0 explicit boot coordinator"
	depends on BR2_PACKAGE_MUOS_R35S_SESSION
	help
	  Opt-in coordinator and inactive inittab template. Requires the
	  guarded C07 infrastructure in the candidate. No persistent settings,
	  generic rcS, boot activation or power permission is enabled by this.
```

## port/buildroot/package/muos-r35s-launcher-once/Config.in
```kconfig
config BR2_PACKAGE_MUOS_R35S_LAUNCHER_ONCE
	bool "R35S guarded one-shot launcher (C25)"
	depends on BR2_PACKAGE_MUOS_R35S_SESSION
	help
	  Install the C25 selection/session helpers without activating init.
	  A reviewed image hook must install the dispatcher and foundation hashes.
	  UI defaults remain off. Only a boot-specific durable token permits UI.
```

## port/buildroot/package/muos-r35s-profile/Config.in
```kconfig
config BR2_PACKAGE_MUOS_R35S_PROFILE
	bool "R35S Panel 0 reviewed private runtime profile"
	depends on BR2_PACKAGE_MUOS_CORE
	help
	  Package the reviewed data profile. Apply it after rootfs overlays using
	  the explicit phase4 runtime post-build hook. UI remains disabled.
```

## port/buildroot/package/muos-r35s-session/Config.in
```kconfig
config BR2_PACKAGE_MUOS_R35S_SESSION
	bool "R35S Panel 0 controlled bring-up session"
	depends on BR2_PACKAGE_MUOS_R35S_PROFILE
	depends on BR2_PACKAGE_LIBDRM
	depends on BR2_PACKAGE_UTIL_LINUX_BINARIES
	depends on BR2_PACKAGE_UTIL_LINUX_MOUNT
	help
	  Disabled-by-default start/status/stop service with bounded lease,
	  private configuration namespace and rollback. Optional typed preferences
	  use a package-local card guard and require the payload manifest.
	  No boot coordinator dependency or activation. Not full muOS rcS.
```

## port/buildroot/package/muos-r35s-wifi-only/Config.in
```kconfig
config BR2_PACKAGE_MUOS_R35S_WIFI_ONLY
	bool "R35S Panel 0 Wi-Fi-only USB policy"
	depends on BR2_aarch64
	help
	  Opt-in policy reviewed with the 0bda:c820 composite dongle on Panel 0.
	  Block btusb alias autoload so autonomous HCI setup does not interfere
	  with Wi-Fi at boot. Applies to all btusb adapters in this image.
	  Bluetooth is not supported by this policy. No module, kernel, boot
	  selector or private network settings are replaced.
```

## port/buildroot/package/muos-rumble/Config.in
```kconfig
config BR2_PACKAGE_MUOS_RUMBLE
	bool "muOS R35S rumble tool"
	help
	  /usr/libexec/muos-rumble: plays the gamepad's FF_RUMBLE effect
	  and probes whether a rumble motor is fitted (battery current with
	  the motor off and on). Driven by /usr/libexec/muos-rumble-setup.
```

## port/buildroot/package/muos-save-store/Config.in
```kconfig
config BR2_PACKAGE_MUOS_SAVE_STORE
	bool "muOS bounded snapshot store (manual caller only)"
	depends on BR2_aarch64
	default n
	select BR2_PACKAGE_ZLIB
	help
	  Root-only snapshot CLI with explicit identity, atomic publication and
	  previous-generation recovery. Installs no service, boot hook, store
	  directory, mount policy or automatic writer. The platform caller must
	  validate the card and private mount before invoking the utility.
	  No ROM, emulator core or user save data is included.
```

## port/buildroot/package/muos-sdl-audio-probe/Config.in
```kconfig
config BR2_PACKAGE_MUOS_SDL_AUDIO_PROBE
	bool "muOS SDL audio probe"
	depends on BR2_PACKAGE_SDL2
	help
	  /usr/libexec/muos-sdl-audio-probe: lists the audio drivers SDL2
	  registers (--require DRIVER fails the build when the pipewire
	  driver is missing, run under qemu-user) and opens SDL audio the
	  way the muOS frontend does (T2 audio probe).
```

## port/buildroot/package/muos-sftp-static/Config.in
```kconfig
config BR2_PACKAGE_MUOS_SFTP_STATIC
	bool "muOS SFTP jail server (static gesftpserver)"
	depends on BR2_PACKAGE_GESFTPSERVER
	help
	  /opt/muos/bin/aarch64/sftp-server for upstream musftpjail, the
	  muos account of the jailed SFTP and the jail's modes.
```

## port/device/rk-r35s-p0/phase4-rootfs.defconfig
```kconfig
# Headless bring-up configuration only. No muOS payload or graphics integration.
# Validating this configuration does not build a rootfs or establish runtime ABI.
BR2_aarch64=y
BR2_cortex_a35=y
BR2_TOOLCHAIN_BUILDROOT_GLIBC=y
BR2_GCC_VERSION_13_X=y
BR2_TOOLCHAIN_BUILDROOT_CXX=y
BR2_KERNEL_HEADERS_CUSTOM_TARBALL=y
BR2_KERNEL_HEADERS_CUSTOM_TARBALL_LOCATION="https://github.com/christianhaitian/linux/archive/d8402159c04b1044106b4f27b7ed7c22ed09228f.tar.gz"
BR2_PACKAGE_HOST_LINUX_HEADERS_CUSTOM_4_4=y
BR2_PACKAGE_HOST_LINUX_HEADERS_LICENSE_FILES="COPYING"
BR2_REPRODUCIBLE=y
BR2_TARGET_GENERIC_HOSTNAME="muos-r35s"
BR2_TARGET_GENERIC_ISSUE="muOS R35S bring-up candidate"
BR2_INIT_BUSYBOX=y
BR2_ROOTFS_DEVICE_CREATION_DYNAMIC_EUDEV=y
BR2_TARGET_GENERIC_GETTY_PORT="ttyFIQ0"
BR2_PACKAGE_BUSYBOX_SHOW_OTHERS=y
BR2_PACKAGE_BASH=y
BR2_PACKAGE_DBUS=y
BR2_PACKAGE_ALSA_UTILS=y
BR2_PACKAGE_ALSA_UTILS_APLAY=y
BR2_PACKAGE_ALSA_UTILS_AMIXER=y
BR2_PACKAGE_PIPEWIRE=y
BR2_PACKAGE_LUA=y
BR2_PACKAGE_LUA_5_4=y
BR2_PACKAGE_WIREPLUMBER=y
BR2_PACKAGE_UTIL_LINUX=y
BR2_PACKAGE_UTIL_LINUX_BINARIES=y
BR2_PACKAGE_UTIL_LINUX_MOUNT=y
BR2_TARGET_ROOTFS_EXT2=y
BR2_TARGET_ROOTFS_EXT2_4=y
BR2_TARGET_ROOTFS_EXT2_LABEL="ROOTFS"
BR2_TARGET_ROOTFS_EXT2_SIZE="512M"
BR2_TARGET_ROOTFS_EXT2_MKFS_OPTIONS="-O ^64bit,^orphan_file,^metadata_csum_seed,^fast_commit"
# BR2_TARGET_ROOTFS_TAR is not set
```
